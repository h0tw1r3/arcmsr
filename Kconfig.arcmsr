## Kconfig.arcmsr
```kconfig
config SCSI_ARCMSR
	tristate "ARECA (ARC11xx/12xx/13xx/16xx) SATA/SAS RAID Host Adapter"
	depends on PCI && SCSI
	help
	  This driver supports all of ARECA's SATA/SAS RAID controllers cards.
	  This is an ARECA maintained driver by Erich Chen. If you have any
	  problems, please mail to <erich@areca.com.tw>.
	  Areca suports its Linux RAID Management Tools
	  Please contact < http://www.areca.com.tw >
			 <  ftp://ftp.areca.com.tw >
	  To compile this driver as a module, choose M here: the
	  module will be called arcmsr.
	  
config SCSI_ARCMSR_AER
	bool "Enable PCI Error Recovery Capability in Areca Driver(ARCMSR)"
	depends on SCSI_ARCMSR && PCIEAER
	default n
	help
	  The advanced error reporting(AER) capability is "NOT" provided by 
	  ARC1200/1201/1202 SATA RAID controllers cards. 
	  If your card is one of ARC1200/1201/1202, please use the default setting, n.
	  If your card is other models, you could pick it 
	  on condition that the kernel version is greater than 2.6.19.
	  This function is maintained driver by Nick Cheng. If you have any
	  problems or suggestion, you are welcome to contact with <nick.cheng@areca.com.tw>.
	  To enable this function, choose Y here.
```
